## libraries/drivers/drv_enet/enet_phy/Kconfig
```kconfig
menuconfig BSP_USING_PHY
    bool "Enable PHY drivers"
    select RT_USING_PHY
    default n

    if BSP_USING_PHY

        choice
            prompt "Choose PHY chips"
            default BSP_USING_ENET_PHY_RTL8201

                config BSP_USING_ENET_PHY_RTL8201
                    bool "RTL8201"

                config BSP_USING_ENET_PHY_RTL8211
                    bool "RTL8211"

                config BSP_USING_ENET_PHY_LAN8720
                    bool "LAN8720"

                config BSP_USING_ENET_PHY_DP83867
                    bool "DP83867"

                config BSP_USING_ENET_PHY_DP83848
                    bool "DP83848"
        endchoice

        config BSP_USING_ENET_PHY_ADDR
            int "Set the address for phy chips"
            default 1
            range 0 30

        config PHY_RESET_PIN_NAME
            string "Set the phy reset pin name"
            default "PA.0"

    endif
```

## offline-packages/iot/Kconfig
```kconfig
menu "IoT - internet of things"

source "$OFFLINE_PKGS_DIR/iot/pahomqtt/Kconfig"
source "$OFFLINE_PKGS_DIR/iot/webclient/Kconfig"
source "$OFFLINE_PKGS_DIR/iot/nopoll/Kconfig"
source "$OFFLINE_PKGS_DIR/iot/netutils/Kconfig"
source "$OFFLINE_PKGS_DIR/iot/ppp_device/Kconfig"
source "$OFFLINE_PKGS_DIR/iot/ota_downloader/Kconfig"

endmenu
```

## offline-packages/iot/ppp_device/Kconfig
```kconfig
# Kconfig file for package ppp_device
menuconfig OPKG_USING_PPP_DEVICE
    bool "PPP DEVICE: lwIP PPP porting for Cellular Module( 2G/3G/4G )"
    default n
    select RT_USING_SAL
    select RT_USING_LWIP
    select RT_LWIP_PPP
    select RT_LWIP_PPPOS

if OPKG_USING_PPP_DEVICE

    config PPP_DEVICE_DEBUG
        bool "Enable debug log output"
        default n

    config PPP_DEVICE_DEBUG_TX
        depends on PPP_DEVICE_DEBUG
        bool "Enable debug for tx data"
        default n

    config PPP_DEVICE_DEBUG_RX
        depends on PPP_DEVICE_DEBUG
        bool "Enable debug for rx data"
        default n

    config PPP_DEVICE_DEBUG_DROP
        depends on PPP_DEVICE_DEBUG
        bool "Enable debug for drop data"
        default n

    config PPP_LCP_LINK_DETECT
        bool "Enable link status detect feature"
        default y

    if PPP_LCP_LINK_DETECT

       config LCP_ECHOINTERVAL
           int "Link status detect timeout"
           default 10
           range 1 20

    endif

    choice
    prompt "APN access point choice"
    default CFG_PPP_USING_PUBLIC_APN

    config CFG_PPP_USING_PUBLIC_APN
        bool "using common APN provider"
    config CFG_PPP_USING_PRIVATE_APN
        bool "using private APN provider"
    endchoice

    if CFG_PPP_USING_PUBLIC_APN
    choice
        prompt "Select Internet Service Provider"
        default CFG_PPP_APN_CMCC

        config CFG_PPP_APN_CMCC
            bool "china mobile"

        config CFG_PPP_APN_CUCC
            bool "china unicom"

        config CFG_PPP_APN_CTCC
            bool "china telecom"
    endchoice
    endif

    if CFG_PPP_USING_PRIVATE_APN
    config PPP_PRIVATE_APN
        string "the name of APN access point"
        default "xxx"

    config PPP_PRIVATE_APN_ACCOUNT
        string "the name of apn access account"

    config PPP_PRIVATE_APN_PASSWORD
        string "the name of apn access password"
    endif

    choice
        prompt "Select modem type"
        default CFG_PPP_DEVICE_USING_AIR720

        config CFG_PPP_DEVICE_USING_AIR720
            bool "Luat Air720"

        config CFG_PPP_DEVICE_USING_EC20
            bool "Quectel EC20"

        config CFG_PPP_DEVICE_USING_EC600X
            bool "Quectel EC600X"

        config CFG_PPP_DEVICE_USING_M6312
            bool "China mobile M6312"

        config CFG_PPP_DEVICE_USING_SIM800
            bool "SIMCOM SIM800"
    endchoice

    config PPP_DEVICE_SAMPLE
        bool "Enable sample to use ppp device"
        default y

    if PPP_DEVICE_SAMPLE

    config PPP_CLIENT_NAME
        string "ppp device uart name"
        default "uart3"

    endif

endif
```

## offline-packages/multimedia/Kconfig
```kconfig
menu "multimedia packages"

source "$OFFLINE_PKGS_DIR/multimedia/lvgl-7/Kconfig"
source "$OFFLINE_PKGS_DIR/multimedia/lvgl-8/Kconfig"

endmenu
```

## offline-packages/multimedia/lvgl-7/Kconfig
```kconfig
# Kconfig file for LVGL v7.11.0
menuconfig PKG_USING_LVGL7
    bool "LVGL7 (official): Light and Versatile Graphics Library"
    default n

if PKG_USING_LVGL7

    config PKG_LVGL_THREAD_PRIO
        int "Priority of LVGL thread"
        default 20

    config PKG_LVGL_THREAD_STACK_SIZE
        int "Stack size of LVGL thread"
        default 4096

    config PKG_LVGL_DISP_REFR_PERIOD
        int "Display refresh period (ms)"
        default 5 # official suggestion

    config PKG_LVGL_USING_SQUARELINE
        bool "Support SquareLine Studio"
        default n

    config PKG_LVGL_USING_EXAMPLES
        bool "Enable built-in examples"
        default n

    config PKG_LVGL_USING_DEMOS
        bool "Enable built-in demos"
        default n

endif
```

## offline-packages/tools/Kconfig
```kconfig
menu "tools packages"

source "$OFFLINE_PKGS_DIR/tools/easyflash/Kconfig"
source "$OFFLINE_PKGS_DIR/tools/segger-rtt/Kconfig"

endmenu
```

## offline-packages/tools/segger-rtt/Kconfig
```kconfig
# Kconfig file for package SEGGER_RTT
menuconfig PKG_USING_SEGGER_RTT
    bool "SEGGER Real Time Transfer (RTT)"
    default n

if PKG_USING_SEGGER_RTT

    choice
        prompt "Console type"
        default SEGGER_RTT_ENABLE
        help
            Select the transport type

        config SEGGER_RTT_ENABLE
            bool "SEGGER RTT support"

        config SWO_ENABLE
            bool "ARM CORTEX M SWO support"
    endchoice

    choice
        prompt "UP Operating modes"
        default SEGGER_RTT_UP_MODE_NO_BLOCK_SKIP
        help
            Define behavior if buffer is full (not enough space for entire message).

        config SEGGER_RTT_UP_MODE_NO_BLOCK_SKIP
            bool "Skip. Do not block, output nothing."

        config SEGGER_RTT_UP_MODE_NO_BLOCK_TRIM
            bool "Trim: Do not block, output as much as fits."

        config SEGGER_RTT_UP_MODE_BLOCK_IF_FIFO_FULL
            bool "Block: Wait until there is space in the buffer."
    endchoice

    config SEGGER_RTT_MAX_NUM_UP_BUFFERS
        int "SEGGER_RTT_MAX_NUM_UP_BUFFERS"
        depends on SEGGER_RTT_ENABLE
        help
            Max. number of up-buffers (T->H) available on this target    (Default: 3)
        default 3

    config SEGGER_RTT_MAX_NUM_DOWN_BUFFERS
        int "SEGGER_RTT_MAX_NUM_DOWN_BUFFERS"
        depends on SEGGER_RTT_ENABLE
        help
            Max. number of down-buffers (H->T) available on this target  (Default: 3)
        default 3

    config BUFFER_SIZE_UP
        int "BUFFER_SIZE_UP"
        depends on SEGGER_RTT_ENABLE
        help
            Size of the buffer for terminal output of target, up to host (Default: 1k)
        default 1024

    config BUFFER_SIZE_DOWN
        int "BUFFER_SIZE_DOWN"
        depends on SEGGER_RTT_ENABLE
        help
            Size of the buffer for terminal input to target from host (Usually keyboard input) (Default: 16)
        default 16

    config SEGGER_RTT_PRINTF_BUFFER_SIZE
        int "SEGGER_RTT_PRINTF_BUFFER_SIZE"
        depends on SEGGER_RTT_ENABLE
        help
            Size of buffer for RTT printf to bulk-send chars via RTT  
        default 64
        
    config RTT_DEFAULT_BUFFER_INDEX
        int "RTT_DEFAULT_BUFFER_INDEX"
        depends on SEGGER_RTT_ENABLE
        default 0
        
    config RTT_DEFAULT_TERMINAL_INDEX
        int "RTT_DEFAULT_TERMINAL_INDEX"
        depends on SEGGER_RTT_ENABLE
        default 0

    config SWO_PORT_NUMBER
        int "SWO port number"
        depends on SWO_ENABLE
        default 0

endif
```

## utility/Kconfig
```kconfig
menu "Utility Config"

    config UTILITY_USING_I2CDETECT
        bool "Enable the i2cdetect command"
        select RT_USING_I2C
        default n

    config UTILITY_USING_RANDOM
        bool "Enable the random supports"
        default n

    config UTILITY_USING_REBOOT
        bool "Enable the reboot command"
        default n

    config UTILITY_USING_PRINT_CLK
        bool "Enable the print clock command"
        default n

endmenu
```
