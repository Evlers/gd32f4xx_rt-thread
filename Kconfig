## Kconfig
```kconfig
mainmenu "RT-Thread Configuration"

config BSP_DIR
    string
    option env="BSP_ROOT"
    default "."

config RTT_DIR
    string
    option env="RTT_ROOT"
    default "rt-thread"

config PKGS_DIR
    string
    option env="PKGS_ROOT"
    default "packages"

config OFFLINE_PKGS_DIR
    string
    default "offline-packages"

source "$RTT_DIR/Kconfig"
# source "$PKGS_DIR/Kconfig"
source "$OFFLINE_PKGS_DIR/Kconfig"
source "libraries/Kconfig"
source "board/Kconfig"
```

## board/Kconfig
```kconfig
menu "System Extension Configuration"

    menuconfig RT_USING_INDEPENDENT_INTERRUPT_MANAGEMENT
        bool "Enable independent interrupt management"
        default n

        if RT_USING_INDEPENDENT_INTERRUPT_MANAGEMENT
            config RT_MAX_SYSCALL_INTERRUPT_PRIORITY
                int "Set max syscall interrupt priority"
                range 0 7
                default 2
        endif

endmenu

menu "Hardware Drivers Config"

config SOC_SERIES_GD32F4xx
    bool
    default y

config SOC_GD32470Z
    bool
    select SOC_SERIES_GD32F4xx
    select RT_USING_COMPONENTS_INIT
    select RT_USING_USER_MAIN
    default y

menu "Onboard Peripheral Drivers"

    menuconfig BSP_USING_SDCARD_FS
        bool "Enable SDCARD filesystem"
        select BSP_USING_SDIO
        select RT_USING_DFS_ELMFAT
        default n

        if BSP_USING_SDCARD_FS
            config SDCARD_FS_BLK_DEV_NAME
                string "Set name for block device"
                default "sd0"
        endif

    menuconfig BSP_USING_SPI_FLASH_FS
        bool "Enable SPI FLASH filesystem"
        select BSP_USING_SPI_FLASH
        select RT_USING_MTD_NOR
        default n

        if BSP_USING_SPI_FLASH_FS
            config SPI_FLASH_FS_PART_NAME
                string "Set name for fal partition"
                default "filesystem"
        endif

    menuconfig BSP_USING_SPI_FLASH
        bool "Enable SPI FLASH"
        select BSP_USING_SPI
        select RT_USING_FAL
        select RT_USING_SFUD
        default n

        if BSP_USING_SPI_FLASH

            config SPI_FLASH_BLK_DEVICE_NAME
                string "Set name for flash block devices"
                default "norflash0"

            config SPI_FLASH_BUS_NAME
                string "Set name for spi bus"
                default "spi1"

            config SPI_FLASH_CS_PIN_NAME
                string "Set the spi cs pin name"
                default "PA.0"

        endif

endmenu

menu "On-chip Peripheral Drivers"

    source "libraries/drivers/Kconfig"

endmenu

menu "Board extended module Drivers"
    config RW007_USING_POWER_MANAGE
        bool "Enable power manage for RW007 wifi modules"
        depends on PKG_USING_RW007
        default n
endmenu

endmenu
```

## libraries/Kconfig
```kconfig
config SOC_FAMILY_GD32
    bool

config SOC_SERIES_GD32F1xx
    bool
    select ARCH_ARM_CORTEX_M3
    select SOC_FAMILY_GD32

config SOC_SERIES_GD32F2xx
    bool
    select ARCH_ARM_CORTEX_M3
    select SOC_FAMILY_GD32

config SOC_SERIES_GD32F3xx
    bool
    select ARCH_ARM_CORTEX_M4
    select SOC_FAMILY_GD32

config SOC_SERIES_GD32F4xx
    bool
    select ARCH_ARM_CORTEX_M4
    select SOC_FAMILY_GD32

menu "External Libraries"

    source "$RTT_DIR/../libraries/wifi-host-driver/Kconfig"

endmenu
```

## libraries/drivers/Kconfig
```kconfig
if BSP_USING_USBD
    config BSP_USBD_TYPE_FS
        bool
        # "USB Full Speed (FS) Core"
    config BSP_USBD_TYPE_HS
        bool
        # "USB High Speed (HS) Core"

    config BSP_USBD_SPEED_HS
        bool
        # "USB High Speed (HS) Mode"
    config BSP_USBD_SPEED_HSINFS
        bool
        # "USB High Speed (HS) Core in FS mode"

    config BSP_USBD_PHY_EMBEDDED
        bool
        # "Using Embedded phy interface"
    config BSP_USBD_PHY_UTMI
        bool
        # "UTMI: USB 2.0 Transceiver Macrocell Interace"
    config BSP_USBD_PHY_ULPI
        bool
        # "ULPI: UTMI+ Low Pin Interface"
endif

config BSP_USING_GPIO
    bool "Enable GPIO"
    select RT_USING_PIN
    default y

menuconfig BSP_USING_UART
    bool "Enable UART"
    default y
    select RT_USING_SERIAL
            if BSP_USING_UART
        config BSP_USING_UART0
            bool "Enable UART0"
            default y

        config BSP_UART0_RX_USING_DMA
            bool "Enable UART0 RX DMA"
            depends on BSP_USING_UART0
            select RT_SERIAL_USING_DMA
            default n

        config BSP_UART0_TX_USING_DMA
            bool "Enable UART0 TX DMA"
            depends on BSP_USING_UART0
            select RT_SERIAL_USING_DMA
            default n

        config BSP_UART0_RX_BUFSIZE
            int "Set UART0 RX buffer size"
            range 64 65535
            depends on BSP_USING_UART0 && RT_USING_SERIAL_V2
            default 64

        config BSP_UART0_TX_BUFSIZE
            int "Set UART0 TX buffer size"
            range 0 65535
            depends on BSP_USING_UART0 && RT_USING_SERIAL_V2
            default 0

        config BSP_USING_UART1
            bool "Enable UART1"
            default n

        config BSP_UART1_RX_USING_DMA
            bool "Enable UART1 RX DMA"
            depends on BSP_USING_UART1
            select RT_SERIAL_USING_DMA
            default n

        config BSP_UART1_TX_USING_DMA
            bool "Enable UART1 TX DMA"
            depends on BSP_USING_UART1
            select RT_SERIAL_USING_DMA
            default n

        config BSP_UART1_RX_BUFSIZE
            int "Set UART1 RX buffer size"
            range 64 65535
            depends on BSP_USING_UART1 && RT_USING_SERIAL_V2
            default 64

        config BSP_UART1_TX_BUFSIZE
            int "Set UART1 TX buffer size"
            range 0 65535
            depends on BSP_USING_UART1 && RT_USING_SERIAL_V2
            default 0

        config BSP_USING_UART2
            bool "Enable UART2"
            default n

        config BSP_UART2_RX_USING_DMA
            bool "Enable UART2 RX DMA"
            depends on BSP_USING_UART2
            select RT_SERIAL_USING_DMA
            default n

        config BSP_UART2_TX_USING_DMA
            bool "Enable UART2 TX DMA"
            depends on BSP_USING_UART2
            select RT_SERIAL_USING_DMA
            default n
        
        config BSP_UART2_RX_BUFSIZE
            int "Set UART2 RX buffer size"
            range 64 65535
            depends on BSP_USING_UART2 && RT_USING_SERIAL_V2
            default 64

        config BSP_UART2_TX_BUFSIZE
            int "Set UART2 TX buffer size"
            range 0 65535
            depends on BSP_USING_UART2 && RT_USING_SERIAL_V2
            default 0

        config BSP_USING_UART3
            bool "Enable UART3"
            default n

        config BSP_UART3_RX_USING_DMA
            bool "Enable UART3 RX DMA"
            depends on BSP_USING_UART3
            select RT_SERIAL_USING_DMA
            default n

        config BSP_UART3_TX_USING_DMA
            bool "Enable UART3 TX DMA"
            depends on BSP_USING_UART3
            select RT_SERIAL_USING_DMA
            default n

        config BSP_UART3_RX_BUFSIZE
            int "Set UART3 RX buffer size"
            range 64 65535
            depends on BSP_USING_UART3 && RT_USING_SERIAL_V2
            default 64

        config BSP_UART3_TX_BUFSIZE
            int "Set UART3 TX buffer size"
            range 0 65535
            depends on BSP_USING_UART3 && RT_USING_SERIAL_V2
            default 0

        config BSP_USING_UART4
            bool "Enable UART4"
            default n

        config BSP_UART4_RX_USING_DMA
            bool "Enable UART4 RX DMA"
            depends on BSP_USING_UART4
            select RT_SERIAL_USING_DMA
            default n

        config BSP_UART4_TX_USING_DMA
            bool "Enable UART4 TX DMA"
            depends on BSP_USING_UART4
            select RT_SERIAL_USING_DMA
            default n

        config BSP_UART4_RX_BUFSIZE
            int "Set UART4 RX buffer size"
            range 64 65535
            depends on BSP_USING_UART4 && RT_USING_SERIAL_V2
            default 64

        config BSP_UART4_TX_BUFSIZE
            int "Set UART4 TX buffer size"
            range 0 65535
            depends on BSP_USING_UART4 && RT_USING_SERIAL_V2
            default 0

        config BSP_USING_UART5
            bool "Enable UART5"
            default n

        config BSP_UART5_RX_USING_DMA
            bool "Enable UART5 RX DMA"
            depends on BSP_USING_UART5
            select RT_SERIAL_USING_DMA
            default n

        config BSP_UART5_TX_USING_DMA
            bool "Enable UART5 TX DMA"
            depends on BSP_USING_UART5
            select RT_SERIAL_USING_DMA
            default n

        config BSP_UART5_RX_BUFSIZE
            int "Set UART5 RX buffer size"
            range 64 65535
            depends on BSP_USING_UART5 && RT_USING_SERIAL_V2
            default 64

        config BSP_UART5_TX_BUFSIZE
            int "Set UART5 TX buffer size"
            range 0 65535
            depends on BSP_USING_UART5 && RT_USING_SERIAL_V2
            default 0

        config BSP_USING_UART6
            bool "Enable UART6"
            default n

        config BSP_UART6_RX_USING_DMA
            bool "Enable UART6 RX DMA"
            depends on BSP_USING_UART6
            select RT_SERIAL_USING_DMA
            default n

        config BSP_UART6_TX_USING_DMA
            bool "Enable UART6 TX DMA"
            depends on BSP_USING_UART6
            select RT_SERIAL_USING_DMA
            default n

        config BSP_UART6_RX_BUFSIZE
            int "Set UART6 RX buffer size"
            range 64 65535
            depends on BSP_USING_UART6 && RT_USING_SERIAL_V2
            default 64

        config BSP_UART6_TX_BUFSIZE
            int "Set UART6 TX buffer size"
            range 0 65535
            depends on BSP_USING_UART6 && RT_USING_SERIAL_V2
            default 0

        config BSP_USING_UART7
            bool "Enable UART7"
            default n

        config BSP_UART7_RX_USING_DMA
            bool "Enable UART7 RX DMA"
            depends on BSP_USING_UART7
            select RT_SERIAL_USING_DMA
            default n

        config BSP_UART7_TX_USING_DMA
            bool "Enable UART7 TX DMA"
            depends on BSP_USING_UART7
            select RT_SERIAL_USING_DMA
            default n

        config BSP_UART7_RX_BUFSIZE
            int "Set UART7 RX buffer size"
            range 64 65535
            depends on BSP_USING_UART7 && RT_USING_SERIAL_V2
            default 64

        config BSP_UART7_TX_BUFSIZE
            int "Set UART7 TX buffer size"
            range 0 65535
            depends on BSP_USING_UART7 && RT_USING_SERIAL_V2
            default 0
    endif

menuconfig BSP_USING_SPI
    bool "Enable SPI BUS"
    default n
    select RT_USING_SPI
    if BSP_USING_SPI
        config BSP_USING_SPI0
            bool "Enable SPI0 BUS"
            default n

        config BSP_SPI0_TX_USING_DMA
            bool "Enable SPI0 TX DMA"
            depends on BSP_USING_SPI0
            default n

        config BSP_SPI0_RX_USING_DMA
            bool "Enable SPI0 RX DMA"
            depends on BSP_USING_SPI0
            select BSP_SPI0_TX_USING_DMA
            default n

        config BSP_USING_SPI1
            bool "Enable SPI1 BUS"
            default n

        config BSP_SPI1_TX_USING_DMA
            bool "Enable SPI1 TX DMA"
            depends on BSP_USING_SPI1
            default n

        config BSP_SPI1_RX_USING_DMA
            bool "Enable SPI1 RX DMA"
            depends on BSP_USING_SPI1
            select BSP_SPI1_TX_USING_DMA
            default n

        config BSP_USING_SPI2
            bool "Enable SPI2 BUS"
            default n

        config BSP_SPI2_TX_USING_DMA
            bool "Enable SPI2 TX DMA"
            depends on BSP_USING_SPI2
            default n

        config BSP_SPI2_RX_USING_DMA
            bool "Enable SPI2 RX DMA"
            depends on BSP_USING_SPI2
            select BSP_SPI2_TX_USING_DMA
            default n

        config BSP_USING_SPI3
            bool "Enable SPI3 BUS"
            default n

        config BSP_SPI3_TX_USING_DMA
            bool "Enable SPI3 TX DMA"
            depends on BSP_USING_SPI3
            default n

        config BSP_SPI3_RX_USING_DMA
            bool "Enable SPI3 RX DMA"
            depends on BSP_USING_SPI3
            select BSP_SPI3_TX_USING_DMA
            default n

        config BSP_USING_SPI4
            bool "Enable SPI4 BUS"
            default n

        config BSP_SPI4_TX_USING_DMA
            bool "Enable SPI4 TX DMA"
            depends on BSP_USING_SPI4
            default n

        config BSP_SPI4_RX_USING_DMA
            bool "Enable SPI4 RX DMA"
            depends on BSP_USING_SPI4
            select BSP_SPI4_TX_USING_DMA
            default n
    endif

menuconfig BSP_USING_I2C1
    bool "Enable I2C1 BUS (software simulation)"
    default n
    select RT_USING_I2C
    select RT_USING_I2C_BITOPS
    select RT_USING_PIN
    if BSP_USING_I2C1
        config BSP_I2C1_SCL_PIN
            int "i2c1 scl pin number"
            range 1 216
            default 24
        config BSP_I2C1_SDA_PIN
            int "I2C1 sda pin number"
            range 1 216
            default 25
    endif

menuconfig BSP_USING_ADC
    bool "Enable ADC"
    default n
    select RT_USING_ADC
    if BSP_USING_ADC
        config BSP_USING_ADC0
            bool "Enable ADC0"
            default n

        config BSP_USING_ADC1
            bool "Enable ADC1"
            default n

        config BSP_USING_ADC2
            bool "Enable ADC2"
            default n
    endif

menuconfig BSP_USING_HWTIMER
    bool "Enable HWTIMER"
    default n
    select RT_USING_HWTIMER
    if BSP_USING_HWTIMER
    config BSP_USING_HWTIMER3
        bool "Enable hardware timer3"
        default n
    config BSP_USING_HWTIMER4
        bool "Enable hardware timer4"
        default n
    config BSP_USING_HWTIMER5
        bool "Enable hardware timer5"
        default n
    endif

menuconfig BSP_USING_RTC
    bool "Enable RTC"
    select RT_USING_RTC
    default n
    if BSP_USING_RTC
        choice
            prompt "Select clock source"
            default BSP_RTC_USING_LSE

            config BSP_RTC_USING_LSE
                bool "RTC USING LSE"

            config BSP_RTC_USING_LSI
                bool "RTC USING LSI"
        endchoice
    endif

config BSP_USING_SDRAM
        bool "Enable SDRAM"
        default n

config BSP_USING_WDT
    bool "Enable Watchdog Timer"
    select RT_USING_WDT
    default n

config BSP_USING_SDIO
    bool "Enable SDIO"
    select RT_USING_SDIO
    select RT_USING_DFS
    default n

menuconfig BSP_USING_ETH
    bool "Enable Ethernet"
    select RT_USING_ETH
    default n

    if BSP_USING_ETH
        config ENET_RXBUF_NUM
            int "Set the number of dma receive buffers"
            default 5

        config ENET_TXBUF_NUM
            int "Set the number of dma transfer buffers"
            default 5

        config BSP_ETH_COMMAND_LINE_DEBUG
            bool "Enable command line debugging"
            default n

        source "libraries/drivers/drv_enet/enet_phy/Kconfig"
    endif

config BSP_USING_USBD
    bool "Enable USB Device"
    select RT_USING_USB_DEVICE
    default n

menuconfig BSP_USING_USBH
    bool "Enable USB Host"
    select RT_USING_USB_HOST
    default n
    if BSP_USING_USBH
        menuconfig RT_USBH_MSTORAGE
            bool "Enable Udisk Drivers"
            default n
            if RT_USBH_MSTORAGE
                config UDISK_MOUNTPOINT
                string "Udisk mount dir"
                default "/"
            endif
    endif

config BSP_USING_ON_CHIP_FLASH
    bool "Enable on-chip FLASH"
    default n
```
